# FM33L0XXD register map
File version: 1.0
CPU: SC000 r1p0, little endian, no MPU, FPU, 8 interrupt priority bits
Registers are 32-bit, read-write, reset 0x0 unless marked. A register's access mark holds for its fields unless they carry their own. Offsets are from the block's base; lines under a group give offsets from that group; [hi:lo] are bit positions; {n}, {i} and the like mark numbered series; 'fields as' and 'values as' point back to an identical list; <NAME> marks a mode.

## Memory map
0x40000000 DBG size 0x8 — DBG module information
0x40000100 PMU size 0x14 — PMU module information
0x40000200 RMU size 0x12608 — RMU module information
0x4000020C RCC size 0x1261C — RCC module information
0x40000400 DMAC size 0x4C — DMAC module information
0x40000800 SPI0 size 0x1C — SPI0 module information
0x40000840 SPI1 size 0x1C — SPI1 module information
0x40000880 SPI2 size 0x1C — SPI2 module information
0x40000C00 GPIOA size 0x20 — GPIOA module information
0x40000C20 GPIOB size 0x20 — GPIOB module information
0x40000C40 GPIOC size 0x20 — GPIOC module information
0x40000C60 GPIOD size 0x20 — GPIOD module information
0x40000C80 GPIOE size 0x20 — GPIOE module information
0x40000CA0 GPIOF size 0x20 — GPIOF module information
0x40000CC0 GPIOG size 0x20 — GPIOG module information
0x40000CE0 GPIO size 0x30 — GPIO module information
0x40000F00 GPIOAHD size 0xC — GPIOAHD module information
0x40000F10 GPIOBHD size 0xC — GPIOBHD module information
0x40000F20 GPIOCHD size 0xC — GPIOCHD module information
0x40000F30 GPIODHD size 0xC — GPIODHD module information
0x40000F40 GPIOEHD size 0xC — GPIOEHD module information
0x40000F50 GPIOFHD size 0xC — GPIOFHD module information
0x40000F60 GPIOGHD size 0xC — GPIOGHD module information
0x40001000 FLASH size 0x24 — FLASH module information
0x40010000 CRC size 0x20 — CRC module information
0x40010400 LPUART0 size 0x24 — LPUART0 module information
0x40010800 LPUART1 size 0x24 — LPUART1 module information
0x40010C00 DISP size 0x5C — DISP module information
0x40011000 RTC size 0x78 — RTC module information
0x40011400 IWDT size 0xC — IWDT module information
0x40011800 WWDT size 0x18 — WWDT module information
0x40011C00 U78160 size 0x2C — U78160 module information
0x40011C2C U78161 size 0x2C — U78161 module information
0x40012000 UARTCOM size 0xC — UARTCOM module information
0x4001200C UART0 size 0x40 — UART0 module information
0x4001202C UART1 size 0x40 — UART1 module information
0x4001204C UART2 size 0x40 — UART2 module information
0x4001206C UART3 size 0x40 — UART3 module information
0x4001208C UART4 size 0x40 — UART4 module information
0x400120AC UART5 size 0x40 — UART5 module information
0x4001238C TRNGCON size 0x4 — TRNGCON module information
0x40012400 I2C0 size 0x1C — I2C0 module information
0x40012800 SVD size 0x68 — SVD module information
0x40012828 SDADC size 0x14 — SDADC module information
0x40012840 COMP1 size 0x4 — COMP1 module information
0x40012844 COMP2 size 0x4 — COMP2 module information
0x40012848 COMPCOM size 0x8 — COMPCOM module information
0x40013000 BSTIM1 size 0x44 — BSTIM1 module information
0x40013044 BSTIM2 size 0x44 — BSTIM2 module information
0x40013090 EXTIM1 size 0xB0 — EXTIM1 module information
0x400130B0 EXTIM2 size 0xB0 — EXTIM2 module information
0x400130D0 EXTIM3 size 0xB0 — EXTIM3 module information
0x400130F0 EXTIM4 size 0xB0 — EXTIM4 module information
0x40013110 EXTIMCOM size 0x10 — EXTIMCOM module information
0x40013400 LPTIM size 0x1C — LPTIM module information
0x40013800 AES size 0x54 — AES module information
0x40013C00 TRNG size 0x20 — TRNG module information
0x40014000 I2C1 size 0x1C — I2C1 module information
0x40014400 GPTIM0 size 0x64 — GPTIM0 module information
0x40014800 GPTIM1 size 0x64 — GPTIM1 module information
0x40015000 SARADC size 0x24 — SARADC module information

## Interrupts
0 WWDT — WWDT interrupt
1 SVD (WWDT) — SVD interrupt
2 RTC (WWDT) — RTC interrupt
3 FLASH (WWDT) — FLASH interrupt
4 FDET (WWDT) — FDET interrupt
5 ADC (WWDT) — ADC interrupt
6 SPI0 (WWDT) — SPI0 interrupt
7 SPI1 (WWDT) — SPI1 interrupt
8 SPI2 (WWDT) — SPI2 interrupt
9 UART0 (WWDT) — UART0 interrupt
10 UART1 (WWDT) — UART1 interrupt
11 UART2 (WWDT) — UART2 interrupt
12 UART3 (WWDT) — UART3 interrupt
13 UART4 (WWDT) — UART4 interrupt
14 UART5 (WWDT) — UART5 interrupt
15 U78160 (WWDT) — U78160 interrupt
16 U78161 (WWDT) — U78161 interrupt
17 I2C (WWDT) — I2C interrupt
18 GPTIMER (WWDT) — GPTIMER interrupt
19 AES (WWDT) — AES interrupt
20 LPTIM (WWDT) — LPTIM interrupt
21 DMA (WWDT) — DMA interrupt
22 WKUPX (WWDT) — WKUPX interrupt
23 COMP (WWDT) — COMP interrupt
24 BT1 (WWDT) — BT1 interrupt
25 BT2 (WWDT) — BT2 interrupt
26 ET1 (WWDT) — ET1 interrupt
27 ET2 (WWDT) — ET2 interrupt
28 ET3 (WWDT) — ET3 interrupt
29 ET4 (WWDT) — ET4 interrupt
30 GPIO (WWDT) — GPIO interrupt
31 LPUART (WWDT) — LPUART interrupt
